/* Copyright (c) 2013, The Linux Foundation. All rights reserved.
 *
 * This program is free software; you can redistribute it and/or modify
 * it under the terms of the GNU General Public License version 2 and
 * only version 2 as published by the Free Software Foundation.
 *
 * This program is distributed in the hope that it will be useful,
 * but WITHOUT ANY WARRANTY; without even the implied warranty of
 * MERCHANTABILITY or FITNESS FOR A PARTICULAR PURPOSE.  See the
 * GNU General Public License for more details.
 */

/*---------------------------------------------------------------------------
 * This file is autogenerated file using gcdb parser. Please do not edit it.
 * Update input XML file to add a new entry or update variable in this file
 * VERSION = "1.0"
 *---------------------------------------------------------------------------*/
&mdss_mdp {
	dsi_hlt2_ili9806e_wvga_vid: qcom,mdss_dsi_hlt2_ili9806e_wvga_video {
		qcom,mdss-dsi-panel-name = "HLT2_ILI9806E wvga video mode dsi panel";
		qcom,cont-splash-enabled;  /* 20131018 tracy add for fix white screen when power on in 1030 SW */ 
		qcom,mdss-dsi-panel-controller = <&mdss_dsi0>;
		qcom,mdss-dsi-panel-type = "dsi_video_mode";
		qcom,mdss-dsi-panel-destination = "display_1";
		/*[20160603][RaymondLin]Modify framerate from 50 to 60 begin*/
		qcom,mdss-dsi-panel-framerate = <60>;
		/*[20160603][RaymondLin]Modify framerate from 50 to 60 end*/
		qcom,mdss-dsi-virtual-channel-id = <0>;
		qcom,mdss-dsi-stream = <0>;
		qcom,mdss-dsi-panel-width = <480>;
		/*20150921 tracy modify for 5815 LCM start*/
		/*qcom,mdss-dsi-panel-height = <800>;*/
		qcom,mdss-dsi-panel-height = <854>;
		/*20150921 tracy modify for 5815 LCM end*/
		/*20160108 tracy add for 5815 LCM x/y dpi start*/
		qcom,mdss-pan-physical-width-dimension=<56>;
		qcom,mdss-pan-physical-height-dimension=<99>;
		/*20160108 tracy add for 5815 LCM x/y dpi end*/
		//[Arima_5833][RaymondLin] Modify LCM parameter from Vendor suggestion begin
		qcom,mdss-dsi-h-front-porch = <80>;
		qcom,mdss-dsi-h-back-porch = <80>;
		qcom,mdss-dsi-h-pulse-width = <10>;
		//[Arima_5833][RaymondLin] Modify LCM parameter from Vendor suggestion end
		qcom,mdss-dsi-h-sync-skew = <0>;

		//[Arima_5833][RaymondLin] Modify LCM parameter from Vendor suggestion begin
		qcom,mdss-dsi-v-back-porch = <12>;
		qcom,mdss-dsi-v-front-porch = <12>;
		qcom,mdss-dsi-v-pulse-width = <4>;
		//[Arima_5833][RaymondLin] Modify LCM parameter from Vendor suggestion end
		/*20151029 tracy modify for modify LCM setting end*/
		qcom,mdss-dsi-h-left-border = <0>;
		qcom,mdss-dsi-h-right-border = <0>;
		qcom,mdss-dsi-v-top-border = <0>;
		qcom,mdss-dsi-v-bottom-border = <0>;
		qcom,mdss-dsi-bpp = <24>;
		qcom,mdss-dsi-underflow-color = <0xff>;
		qcom,mdss-dsi-border-color = <0>;
		/*20160112 tracy modify for 5815 LCM gamma start*/
		/*20150921 tracy modify for 5815 LCM start*/
		qcom,mdss-dsi-on-command = [
		   39 01 00 00 00 00 06
			 FF FF 98 06 04 01
		   15 01 00 00 00 00 02 08 10
		   15 01 00 00 00 00 02 21 01
		   15 01 00 00 00 00 02 30 01
		   15 01 00 00 00 00 02 31 02
		   //15 01 00 00 00 00 02 50 81   /*78*/
		  // 15 01 00 00 00 00 02 51 81   /*78*/
		   15 01 00 00 00 00 02 60 07
		   15 01 00 00 00 00 02 61 00
		   15 01 00 00 00 00 02 62 08
		   15 01 00 00 00 00 02 63 00
		   15 01 00 00 00 00 02 40 15
		   15 01 00 00 00 00 02 41 44
		   15 01 00 00 00 00 02 42 02
		   15 01 00 00 00 00 02 43 02   /*09*/
		   15 01 00 00 00 00 02 44 02   /*09*/
		   15 01 00 00 00 00 02 52 00
		   15 01 00 00 00 00 02 53 3E   /*5B*/
		   //15 01 00 00 00 00 02 57 50
                 39 01 00 00 00 00 06
			 FF FF 98 06 04 01
                   15 01 00 00 00 00 02 A0 00
                   15 01 00 00 00 00 02 A1 07   /*08*/
                   15 01 00 00 00 00 02 A2 13   /*16*/
                   15 01 00 00 00 00 02 A3 11   /*12*/
                   15 01 00 00 00 00 02 A4 09   /*0D*/
		   15 01 00 00 00 00 02 A5 18   /*1F*/
                   15 01 00 00 00 00 02 A6 0A   /*0A*/
                   15 01 00 00 00 00 02 A7 07   /*09*/
                   15 01 00 00 00 00 02 A8 05   /*05*/
                   15 01 00 00 00 00 02 A9 0A   /*06*/
                   15 01 00 00 00 00 02 AA 04   /*02*/
                   15 01 00 00 00 00 02 AB 06   /*05*/
                   15 01 00 00 00 00 02 AC 0F   /*11*/
                   15 01 00 00 00 00 02 AD 34   /*30*/
                   15 01 00 00 00 00 02 AE 2F   /*2D*/
		   15 01 00 00 00 00 02 AF 00
		   15 01 00 00 00 00 02 C0 00
                   15 01 00 00 00 00 02 C1 07   /*03*/
                   15 01 00 00 00 00 02 C2 0F   /*0F*/
                   15 01 00 00 00 00 02 C3 0E   /*12*/
                   15 01 00 00 00 00 02 C4 09   /*0A*/
                   15 01 00 00 00 00 02 C5 14   /*19*/
                   15 01 00 00 00 00 02 C6 08   /*08*/
                   15 01 00 00 00 00 02 C7 09   /*07*/
                   15 01 00 00 00 00 02 C8 02   /*04*/
                   15 01 00 00 00 00 02 C9 07   /*09*/
                   15 01 00 00 00 00 02 CA 09   /*06*/
                   15 01 00 00 00 00 02 CB 04    /*04*/
                   15 01 00 00 00 00 02 CC 0B   /*08*/
                   15 01 00 00 00 00 02 CD 26   /*21*/
                   15 01 00 00 00 00 02 CE 22   /*1C*/
		   15 01 00 00 00 00 02 CF 00
		   /*20160112 tracy modify for 5815 LCM gamma end*/
		   /*20160119 tracy add for change PWM clock to 20khz start */
		   39 01 00 00 00 00 06
			 FF FF 98 06 04 05
		   15 01 00 00 00 00 02 00 02
		   /*20160119 tracy add for change PWM clock to 20khz end */
		   39 01 00 00 00 00 06
			 FF FF 98 06 04 06
		   15 01 00 00 00 00 02 00 21
		   15 01 00 00 00 00 02 01 09
		   15 01 00 00 00 00 02 02 00
		   15 01 00 00 00 00 02 03 00
		   15 01 00 00 00 00 02 04 01
		   15 01 00 00 00 00 02 05 01
		   15 01 00 00 00 00 02 06 80
		   15 01 00 00 00 00 02 07 05
		   15 01 00 00 00 00 02 08 02
		   15 01 00 00 00 00 02 09 80
		   15 01 00 00 00 00 02 0A 00
		   15 01 00 00 00 00 02 0B 00
		   15 01 00 00 00 00 02 0C 0A
		   15 01 00 00 00 00 02 0D 0A
		   15 01 00 00 00 00 02 0E 00
		   15 01 00 00 00 00 02 0F 00
		   15 01 00 00 00 00 02 10 E0
		   15 01 00 00 00 00 02 11 E4
		   15 01 00 00 00 00 02 12 04
		   15 01 00 00 00 00 02 13 00
		   15 01 00 00 00 00 02 14 00
		   15 01 00 00 00 00 02 15 C0
		   15 01 00 00 00 00 02 16 08
		   15 01 00 00 00 00 02 17 00
		   15 01 00 00 00 00 02 18 00
		   15 01 00 00 00 00 02 19 00
		   15 01 00 00 00 00 02 1A 00
		   15 01 00 00 00 00 02 1B 00
		   15 01 00 00 00 00 02 1C 00
		   15 01 00 00 00 00 02 1D 00
		   15 01 00 00 00 00 02 20 01
		   15 01 00 00 00 00 02 21 23
		   15 01 00 00 00 00 02 22 45
		   15 01 00 00 00 00 02 23 67
		   15 01 00 00 00 00 02 24 01
		   15 01 00 00 00 00 02 25 23
		   15 01 00 00 00 00 02 26 45
		   15 01 00 00 00 00 02 27 67
		   15 01 00 00 00 00 02 30 01
		   15 01 00 00 00 00 02 31 11
		   15 01 00 00 00 00 02 32 00
		   15 01 00 00 00 00 02 33 EE
		   15 01 00 00 00 00 02 34 FF
		   15 01 00 00 00 00 02 35 BB
		   15 01 00 00 00 00 02 36 CA
		   15 01 00 00 00 00 02 37 DD
		   15 01 00 00 00 00 02 38 AC
		   15 01 00 00 00 00 02 39 76
		   15 01 00 00 00 00 02 3A 67
		   15 01 00 00 00 00 02 3B 22
		   15 01 00 00 00 00 02 3C 22
		   15 01 00 00 00 00 02 3D 22
		   15 01 00 00 00 00 02 3E 22
		   15 01 00 00 00 00 02 3F 22
		   15 01 00 00 00 00 02 40 22
		   15 01 00 00 00 00 02 52 10
		   15 01 00 00 00 00 02 53 10
		   //15 01 00 00 00 00 02 54 13
		   39 01 00 00 00 00 06
			 FF FF 98 06 04 07
		   15 01 00 00 00 00 02 17 22	 
		   15 01 00 00 00 00 02 02 77
		  // 15 01 00 00 00 00 02 E1 79
		   //15 01 00 00 00 00 02 26 B2
		   //15 01 00 00 00 00 02 B3 10
		   //15 01 00 00 00 00 02 06 13
		    /*20151211 tracy add for fixed 2nd lcm blinking when change brightness start*/
		   39 01 00 00 00 00 06
			 FF FF 98 06 04 05
		   15 01 00 00 00 00 02 0E 03 
		   /*20151211 tracy add for fixed 2nd lcm blinking when change brightness end*/
		   39 01 00 00 00 00 06
			 FF FF 98 06 04 00
		   05 01 00 00 78 00 02 11 00
		   05 01 00 00 0A 00 02 29 00
		   //[Arima_5833][RaymondLin] fix LCM resume backlight not work begin
		   /*20151109 tracy remove for fixed white screen when wakeup start*/
		   15 01 00 00 00 00 02 53 24
		   /*20151109 tracy remove for fixed white screen when wakeup end*/
		   //[Arima_5833][RaymondLin] fix LCM resume backlight not work end
					];  
		  /*20131014 tracy modify for LCM HW detect*/
               /*20150921 tracy modify for 5815 LCM end*/
		
		/*20151228 tracy modify LCM sleep delay time start */
		/*20151225 tracy modify LCM sleep delay time start */		
		qcom,mdss-dsi-off-command = [
		/*05 01 00 00 78 00 02 28 00*/
		/*05 01 00 00 0A 00 02 10 00*/
		05 01 00 00 0A 00 02 28 00
		05 01 00 00 78 00 02 10 00
		];
                /*20151225 tracy modify LCM sleep delay time end */
		/*20151228 tracy modify LCM sleep delay time end */
				
		/*20131030 tracy add  for LCM esd test*/
		qcom,mdss-dsi-esd-command = [
                   39 01 00 00 05 00 03 02 00 00
                   39 01 00 00 05 00 03 32 00 00
                   39 01 00 00 05 00 03 38 00 00
                   39 01 00 00 05 00 03 20 00 00
                   39 01 00 00 05 00 03 11 00 00
                   39 01 00 00 05 00 03 29 00 00
		];
		
		/*20131030 tracy add  for LCM esd test*/						  
		qcom,mdss-dsi-on-command-state = "dsi_lp_mode";
		/*20160112 tracy modify for degug flash  start*/
		/*qcom,mdss-dsi-off-command-state = "dsi_lp_mode";*/
		qcom,mdss-dsi-off-command-state = "dsi_hs_mode";
		/*20160112 tracy modify for degug flash  end*/
		qcom,mdss-dsi-esd-state = "dsi_lp_mode";/*20131030 tracy add  for LCM esd test*/	
		qcom,mdss-dsi-h-sync-pulse = <1>;
		qcom,mdss-dsi-traffic-mode = "burst_mode";
		//[Arima_5833][RaymondLin] Modify LCM parameter from Vendor suggestion begin
		qcom,mdss-dsi-lane-map = "lane_map_0123";
		//[Arima_5833][RaymondLin] Modify LCM parameter from Vendor suggestion end
		/*20131030 tracy add  for LCM esd test*/
		qcom,mdss-dsi-bllp-eof-power-mode=<1>;
		qcom,mdss-dsi-bllp-power-mode=<1>;
		/*20131030 tracy add  for LCM esd test*/
		qcom,mdss-dsi-lane-0-state;
		qcom,mdss-dsi-lane-1-state;
		/*20150921 tracy modify for 5815 LCM start */
		qcom,mdss-dsi-panel-timings = [75 1A 11 00 3D 45 15 1D 1C 03 04 00];
              //qcom,mdss-dsi-panel-timings = [78 1B 11 00 3E 43 16 1E 1D 03 04 00];
		/*20150921 tracy modify for 5815 LCM end */
		qcom,mdss-dsi-t-clk-post = <0x04>;
		/*20150921 tracy modify for 5815 LCM start*/
		/*qcom,mdss-dsi-t-clk-pre = <0x18>;*/
		qcom,mdss-dsi-t-clk-pre = <0x19>;
		/*20150921 tracy modify for 5815 LCM end*/
		qcom,mdss-dsi-bl-min-level = <1>;
		qcom,mdss-dsi-bl-max-level = <255>;
		qcom,mdss-dsi-dma-trigger = "trigger_sw";
		qcom,mdss-dsi-mdp-trigger = "none";
		/*20151029 tracy modify for backlight control start*/
		/*qcom,mdss-dsi-bl-pmic-control-type = "bl_ctrl_wled";*/
		qcom,mdss-dsi-bl-pmic-control-type = "bl_ctrl_dcs";
		/*20151029 tracy modify for backlight control end*/
		qcom,mdss-dsi-reset-sequence = <1 20>, <0 2>, <1 20>;
	};
};
