/* Copyright (c) 2013, The Linux Foundation. All rights reserved.
 *
 * This program is free software; you can redistribute it and/or modify
 * it under the terms of the GNU General Public License version 2 and
 * only version 2 as published by the Free Software Foundation.
 *
 * This program is distributed in the hope that it will be useful,
 * but WITHOUT ANY WARRANTY; without even the implied warranty of
 * MERCHANTABILITY or FITNESS FOR A PARTICULAR PURPOSE.  See the
 * GNU General Public License for more details.
 */

/*---------------------------------------------------------------------------
 * This file is autogenerated file using gcdb parser. Please do not edit it.
 * Update input XML file to add a new entry or update variable in this file
 * VERSION = "1.0"
 *---------------------------------------------------------------------------*/
&mdss_mdp {
	dsi_r69339_720p_video: qcom,mdss_dsi_r69339_720p_video {
		qcom,mdss-dsi-panel-name = "sharp r69339 720p video mode dsi panel";
		qcom,mdss-dsi-panel-controller = <&mdss_dsi0>;
		qcom,mdss-dsi-panel-type = "dsi_video_mode";
		qcom,mdss-dsi-panel-destination = "display_1";
		qcom,mdss-dsi-panel-framerate = <60>;
		qcom,mdss-dsi-virtual-channel-id = <0>;
		qcom,mdss-dsi-stream = <0>;
		qcom,mdss-dsi-panel-width = <720>;
		qcom,mdss-dsi-panel-height = <1280>;
		qcom,mdss-dsi-h-front-porch = <100>;
		qcom,mdss-dsi-h-back-porch = <40>;	
		qcom,mdss-dsi-h-pulse-width = <12>;	
		qcom,mdss-dsi-h-sync-skew = <0>;
		qcom,mdss-dsi-v-back-porch = <11>;
		qcom,mdss-dsi-v-front-porch = <13>;
		qcom,mdss-dsi-v-pulse-width = <1>;
		qcom,mdss-dsi-h-left-border = <0>;
		qcom,mdss-dsi-h-right-border = <0>;
		qcom,mdss-dsi-v-top-border = <0>;
		qcom,mdss-dsi-v-bottom-border = <0>;
		//[5833][RaymondLin] Fix stack error issue begin
		//[Arima_5830][RaymondLin] backlight IC KTD3116-1 control begin
		//qcom,platform-bklight-en-gpio = <98>;
		//[Arima_5830][RaymondLin] backlight IC KTD3116-1 control end
		//[5833][RaymondLin] Fix stack error issue end
		qcom,mdss-dsi-bpp = <24>;
		qcom,mdss-dsi-underflow-color = <0xff>;
		qcom,mdss-dsi-border-color = <0>;
		qcom,mdss-dsi-on-command = [
			  //39 01 00 00 00 00 02						
			   //51 80		
			   //[5830][RaymondLin]improve backlight not smoth in low level brightness -20160808 begin
			   39 01 00 00 00 00 02						
			   B0 00
			   39 01 00 00 00 00 02						
			   D6 01
			   39 01 00 00 00 00 07						
			   B8 07 87 26 18 00 32
			   39 01 00 00 00 00 07						
			   B9 07 75 61 20 16 87
			   39 01 00 00 00 00 07						
			   BA 07 70 81 20 45 B4

			   39 01 00 00 00 00 19						
			   CE 20 40 43 49 53 60
			   6E 7D 8F A0 B2 C5 D7
			   E9 F5 FC FF 04 00 04
			   04 00 04 00
			   
			   39 01 00 00 00 00 02						
			   55 02
			   
			   39 01 00 00 00 00 02						
			   53 24
			   39 01 00 00 00 00 02						
			   51 00
			   39 01 00 00 00 00 02						
			   5E 02
			   //[5830][RaymondLin]improve backlight not smoth in low level brightness -20160808 end 
			   05 01 00 00 00 00 02 29 00
			   05 01 00 00 96 00 02 11 00
	                      ];
		qcom,mdss-dsi-off-command = [
				39 01 00 00 00 00 02 51 00
				05 01 00 00 32 00 02 28 00
				05 01 00 00 78 00 02 10 00
				];
	//[5830][raymondLin]Fixed Sometimes backlight not work after resume issue -20160706 begin 			
		qcom,mdss-dsi-on-command-state = "dsi_hs_mode";
	//[5830][raymondLin]Fixed Sometimes backlight not work after resume issue -20160706 end	
		qcom,mdss-dsi-off-command-state = "DSI_LP_MODE";
		qcom,mdss-dsi-h-sync-pulse = <1>;
		qcom,mdss-dsi-traffic-mode = "burst_mode";
		qcom,mdss-dsi-bllp-eof-power-mode;
		qcom,mdss-dsi-bllp-power-mode;
		qcom,mdss-dsi-lane-0-state;
		qcom,mdss-dsi-lane-1-state;
		qcom,mdss-dsi-lane-2-state;
		qcom,mdss-dsi-lane-3-state;
		//[Arima_5830][RaymondLin] Modify MIPI clock due to HW's request begin
		qcom,mdss-dsi-panel-clockrate = <418000000>;
		qcom,mdss-dsi-panel-timings = [7B 1A 10 00 3E 40 16 1E 15 03 04 00]; 
		qcom,mdss-dsi-t-clk-post = <0x4>;
		qcom,mdss-dsi-t-clk-pre = <0x26>;
		//[Arima_5830][RaymondLin] Modify MIPI clock due to HW's request end
		qcom,mdss-dsi-bl-min-level = <1>;
		qcom,mdss-dsi-bl-max-level = <255>;
		qcom,mdss-dsi-dma-trigger = "trigger_sw";
		qcom,mdss-dsi-mdp-trigger = "none";
		qcom,mdss-dsi-bl-pmic-control-type = "bl_ctrl_dcs";
		qcom,mdss-dsi-reset-sequence = <1 20>, <0 15>, <1 20>;
		qcom,mdss-pan-physical-width-dimension = <72>;
		qcom,mdss-pan-physical-height-dimension = <130>;
		
	};
};
